## boards/shields/span/Kconfig.shield
```kconfig
# Copyright (c) 2020 Pete Johanson
# SPDX-License-Identifier: MIT

config SHIELD_SPAN_LEFT
    def_bool $(shields_list_contains,span_left)

config SHIELD_SPAN_RIGHT
    def_bool $(shields_list_contains,span_right)
```
